/*
    Struttura

	| Settore | KiB | Regione      |
	+---------+-----+--------------+
    |     0   |  16 | UL           |
    |---------+-----+--------------+
	|     1   |  16 | dummy1       |
    |     2   |  16 |              |
    |     3   |  16 |              |
    |     4   |  64 |              |
	|---------+-----+--------------+
    |     5   | 128 | CLD ELE      |
    |     6   | 128 |              |
    |     7   | 128 |              |
	|---------+-----+--------------+
    |     8   | 128 | CLD FUNZ     |
    |     9   | 128 |              |    
    |    10   | 128 |              |    
    |    11   | 128 |              |
    |---------+-----+--------------+
    |    12   |  16 | PRM CLD      |
	|---------+-----+--------------+
    |    13   |  16 | PRM APP      |
    |    14   |  16 |              |
	|---------+-----+--------------+
    |    15   |  16 | dummy2       |
    |    16   |  64 |              |
	|---------+-----+--------------+
    |    17   | 128 | APP          |
    |    18   | 128 |              |
    |    19   | 128 |              |
    |    20   | 128 |              |
    |    21   | 128 |              |
    |    22   | 128 |              |
    |    23   | 128 |              |
    +---------+-----+--------------+

    All'inizio della ram c'e' l'area in comune fra microloader e applicazione
*/

define symbol DIM_UL         =  16K ;
define symbol DIM_DUMMY1     = 112K ;
define symbol DIM_CLD_ELE    = 384K ;
define symbol DIM_CLD_FUNZ   = 512K ;
define symbol DIM_PRM_CLD    =  16K ;
define symbol DIM_PRM_APP    =  32K ;
define symbol DIM_DUMMY2     =  80K ;
define symbol DIM_APP        = 896K ;

/******************* REGIONI **************************************************/

define symbol INIZIO_UL       = ROM_INIZIO ;
define symbol INIZIO_DUMMY1   = INIZIO_UL + DIM_UL;
define symbol INIZIO_CLD_ELE  = INIZIO_DUMMY1 + DIM_DUMMY1 ;
define symbol INIZIO_CLD_FUNZ = INIZIO_CLD_ELE + DIM_CLD_ELE ;
define symbol INIZIO_PRM_CLD  = INIZIO_CLD_FUNZ + DIM_CLD_FUNZ ;
define symbol INIZIO_PRM_APP  = INIZIO_PRM_CLD + DIM_PRM_CLD ;
define symbol INIZIO_DUMMY2   = INIZIO_PRM_APP + DIM_PRM_APP;
define symbol INIZIO_APP      = INIZIO_DUMMY2 + DIM_DUMMY2 ;

define region REGIONE_UL   	  = mem:[from INIZIO_UL       size DIM_UL] ;
define region REGIONE_DUMMY1  = mem:[from INIZIO_DUMMY1   size DIM_DUMMY1] ;
define region REGIONE_CLD_ELE = mem:[from INIZIO_CLD_ELE  size DIM_CLD_ELE] ;
define region REGIONE_CLD_FUNZ= mem:[from INIZIO_CLD_FUNZ size DIM_CLD_FUNZ] ;
define region REGIONE_PRM_CLD = mem:[from INIZIO_PRM_CLD  size DIM_PRM_CLD] ;
define region REGIONE_PRM_APP = mem:[from INIZIO_PRM_APP  size DIM_PRM_APP] ;
define region REGIONE_DUMMY2  = mem:[from INIZIO_DUMMY2   size DIM_DUMMY2] ;
define region REGIONE_APP     = mem:[from INIZIO_APP      size DIM_APP] ;



define region REG_RAM = mem:[from RAM_INIZIO to RAM_FINE] ;
define region REG_CCM = mem:[from CCM_INIZIO to CCM_FINE] ;

/******************* BLOCCHI **************************************************/

define block CODICE with fixed order {        
    readonly section .intvec,
    readonly section DESCRITTORE,
    readonly,
    readonly section ALLINEAMENTO
} ;

//UL
if (!isdefinedsymbol (ALLOCA_UL))
{
	define block UL with size = DIM_UL {} ;
	keep { block UL } ;
}

//dummy1
define block DUMMY1 with size = DIM_DUMMY1 {} ;
keep { block DUMMY1 } ;

//CLD_ELE
if (!isdefinedsymbol (ALLOCA_CLD_ELE))
{
	define block CLD_ELE with size = DIM_CLD_ELE {} ;
	keep { block CLD_ELE } ;
}
//CLD_FUNZ
if (!isdefinedsymbol (ALLOCA_CLD_FUNZ))
{
	define block CLD_FUNZ with size = DIM_CLD_FUNZ {} ;
	keep { block CLD_FUNZ } ;
}

// Parametri
define block PRM_CLD with size = DIM_PRM_CLD {} ;
keep { block PRM_CLD } ;

define block PRM_APP with size = DIM_PRM_APP {} ;
keep { block PRM_APP } ;

//dummy2
define block DUMMY2 with size = DIM_DUMMY2 {} ;
keep { block DUMMY2 } ;

//APP
//if (isdefinedsymbol (ALLOCA_UL) || isdefinedsymbol (ALLOCA_CLD_ELE) || isdefinedsymbol (ALLOCA_CLD_FUNZ))
if (!isdefinedsymbol (ALLOCA_APP))
{
	define block APP with size = DIM_APP {} ;
	keep { block APP } ;
}

// Variabili
define block VARIABILI with fixed order {
	readwrite
} ;


// Scambio informazioni bootloader/applicativo

define symbol DIMENSIONE_RAM_COMUNE = 0x20 ;

define block RAM_COMUNE with size = DIMENSIONE_RAM_COMUNE {} ;
keep { block RAM_COMUNE } ;

// Area CCM 

define block RAM_CCM with size = CCM_FINE - CCM_INIZIO + 1 {
    section RAM_CCM,
} ;
