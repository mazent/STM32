define symbol STACK_DIM = 10K ;
define symbol HEAP_DIM  = 80K ;

include "stm32h735xx.icf" ;

/*
    Struttura

	| Blocco | KiB | Sezione | Programma |
	+--------+-----+---------+-----------+
    |     0  | 128 | ALTRO   | BL        |
    |--------+-----+---------+-----------+
    |     1  | 896 | CODICE  | APP       |
    +--------+-----+---------+-----------+
*/

define symbol DIM_BL  = 128K ;
define symbol DIM_APP = 896K ;


include "sezioni.icf" ;
include "alloca.icf" ;